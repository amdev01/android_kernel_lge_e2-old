/* Copyright (c) 2012, Code Aurora Forum. All rights reserved.
 *
 * This program is free software; you can redistribute it and/or modify
 * it under the terms of the GNU General Public License version 2 and
 * only version 2 as published by the Free Software Foundation.
 *
 * This program is distributed in the hope that it will be useful,
 * but WITHOUT ANY WARRANTY; without even the implied warranty of
 * MERCHANTABILITY or FITNESS FOR A PARTICULAR PURPOSE.  See the
 * GNU General Public License for more details.
 */

&i2c_0{
	 /* BLSP1 QUP2, LGP-s19 sensor devices */
	apds9130@39 {
		compatible = "avago,apds9130";
		status = "ok";
		reg = <0x39>;
		interrupt-parent = <&msm_gpio>;
		interrupts = <113 0x1>;
		sensor_vdd-supply = <&pm8916_l17>;
		sensor_vcc_i2c-supply = <&pm8916_l6>;
		pinctrl-names = "default", "sleep";
		pinctrl-0 = <&apds9130_int_active>;
		pinctrl-1 = <&apds9130_int_suspend>;
		avago,gpio-int = <&msm_gpio 113 0x1>;
	};

	k2dh0@18 {
		status = "ok";
		reg = <0x18>;
		compatible = "st,k2dh";
		interrupt-parent = <&msm_gpio>;
		interrupts = <115 0x0>;
		sensor_vdd-supply = <&pm8916_l17>;
		sensor_vcc_i2c-supply = <&pm8916_l6>;
		pinctrl-names = "default", "sleep";
		pinctrl-0 = <&k2dh_int_active>;
		pinctrl-1 = <&k2dh_int_suspend>;
		st,gpio-int = <&msm_gpio 115 0x0>;
	};

	ak09911@0c {
		status = "ok";
		reg = <0x0c>;
		compatible = "ak,ak09911";
		sensor_vdd-supply = <&pm8916_l17>;
		sensor_vcc_i2c-supply = <&pm8916_l6>;
		pinctrl-names = "default", "sleep";
				pinctrl-0 = <&akm09911_active>;
				pinctrl-1 = <&akm09911_suspend>;
		akm,gpio_rstn = <&msm_gpio 69 0x0>;
				akm,layout = <0x0>;
				akm,auto-report;
	};
};
