/* Copyright (c) 2012, Code Aurora Forum. All rights reserved.
 *
 * This program is free software; you can redistribute it and/or modify
 * it under the terms of the GNU General Public License version 2 and
 * only version 2 as published by the Free Software Foundation.
 *
 * This program is distributed in the hope that it will be useful,
 * but WITHOUT ANY WARRANTY; without even the implied warranty of
 * MERCHANTABILITY or FITNESS FOR A PARTICULAR PURPOSE.  See the
 * GNU General Public License for more details.
 */

&i2c_5 {

	lge_touch@34 {
		status = "ok";
		revision = "rev_a...";
		pinctrl-0 = <&ts_int_active &ts_reset_active>;	/*Touch GPIO pin active setting*/
		pinctrl-1 = <&ts_int_suspend &ts_reset_suspend>;	/*Touch GPIO pin suspend setting*/

		vdd_value0 = <2850000>;
		vdd-supply = <&pm8916_l17>;

		vdd_type1 = <2>;
		vdd_name1 = "vio_i2c";
		vdd_value1 = <1800000>;
		vio_i2c-supply = <&pm8916_l6>;
	};
};
