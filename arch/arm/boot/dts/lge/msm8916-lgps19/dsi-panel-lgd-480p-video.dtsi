&mdss_mdp {
	dsi_lgd_incell_vid: qcom,mdss_dsi_lgd_incell_video{
		compatible = "qcom,mdss-dsi-panel";
		status = "disable";
		qcom,cont-splash-enabled;
		qcom,mdss-dsi-panel-name = "LGD WVGA video mode dsi panel";
		qcom,mdss-dsi-panel-controller = <&mdss_dsi0>;
		qcom,mdss-dsi-panel-type = "dsi_video_mode";
		qcom,mdss-dsi-panel-destination = "display_1";
		qcom,mdss-dsi-panel-framerate = <60>;
		qcom,mdss-dsi-virtual-channel-id = <0>;
		qcom,mdss-dsi-stream = <0>;
		qcom,mdss-dsi-panel-width = <480>;
		qcom,mdss-dsi-panel-height = <800>;
		qcom,mdss-dsi-h-front-porch = <8>;
		qcom,mdss-dsi-h-back-porch = <80>;
		qcom,mdss-dsi-h-pulse-width = <8>;
		qcom,mdss-dsi-h-sync-skew = <0>;
		qcom,mdss-dsi-v-back-porch = <12>;
		qcom,mdss-dsi-v-front-porch = <1050>;
		qcom,mdss-dsi-v-pulse-width = <4>;
		qcom,mdss-dsi-h-left-border = <0>;
		qcom,mdss-dsi-h-right-border = <0>;
		qcom,mdss-dsi-v-top-border = <0>;
		qcom,mdss-dsi-v-bottom-border = <0>;
		qcom,mdss-pan-physical-width-dimension = < 58 >;
		qcom,mdss-pan-physical-height-dimension = < 103 >;
		qcom,mdss-dsi-bpp = <24>;
		qcom,mdss-dsi-color-order = "rgb_swap_rgb";
		qcom,mdss-dsi-underflow-color = <0xff>;
		qcom,mdss-dsi-border-color = <0>;
		qcom,mdss-dsi-on-command = [
			39 01 00 00 00 00 08
			B7 00 26 26 26 26 26 26
			39 01 00 00 00 00 07
			B6 06 0A 34 23 41 0A
			39 01 00 00 00 00 05
			B8 00 42 33 3F

			15 01 00 00 00 00 02
			B0 00
			15 01 00 00 00 00 02
			55 00

			39 01 00 00 00 00 0B
			B5 03 48 01 12 06 48 48 00 00 48
			39 01 00 00 00 00 07
			B4 00 0A 02 02 02 02

			15 01 00 00 00 00 02
			B2 00
			39 01 00 00 00 00 05
			B1 C6 1E 0F 00
			15 01 00 00 00 00 02
			BB 25

			15 01 00 00 00 00 02
			36 00

			39 01 00 00 00 00 02
			D9 A0
			39 01 00 00 00 00 03
			F8 00 05
			39 01 00 00 00 00 03
			D7 00 A6
			39 01 00 00 00 00 03
			BD 00 23

			39 01 00 00 00 00 0A
			D0 42 25 76 26 00 00 55 02 03
			39 01 00 00 00 00 0A
			D1 42 25 76 26 00 00 55 02 03
			39 01 00 00 00 00 0A
			D2 42 25 76 26 00 00 55 02 03
			39 01 00 00 00 00 0A
			D3 42 25 76 26 00 00 55 02 03
			39 01 00 00 00 00 0A
			D4 42 25 76 26 00 00 55 02 03
			39 01 00 00 00 00 0A
			D5 42 25 76 26 00 00 55 02 03


			05 01 00 00 64 00 02
			11 00
			05 01 00 00 64 00 02
			29 00
		];
		qcom,mdss-dsi-off-command = [
			05 01 00 00 32 00 02 28 00
			05 01 00 00 78 00 02 10 00
		];
		qcom,mdss-dsi-on-command-state = "dsi_lp_mode";
		qcom,mdss-dsi-off-command-state = "dsi_hs_mode";
		qcom,mdss-dsi-h-sync-pulse = <0>;
		qcom,mdss-dsi-traffic-mode = "non_burst_sync_event";
		qcom,mdss-dsi-lane-map = "lane_map_0123";
		//qcom,mdss-dsi-hfp-power-mode;
		//qcom,mdss-dsi-hbp-power-mode;
		//qcom,mdss-dsi-hsa-power-mode;
		qcom,mdss-dsi-bllp-eof-power-mode;
		//qcom,mdss-dsi-bllp-power-mode;
		qcom,mdss-dsi-lane-0-state;
		qcom,mdss-dsi-lane-1-state;
		qcom,mdss-dsi-panel-timings = [B1 3A 2D 00 52 47 32 3C 4A 03 04 00];
		qcom,mdss-dsi-t-clk-post = <0x1F>;
		qcom,mdss-dsi-t-clk-pre = <0x32>;
		//qcom,mdss-dsi-bl-min-level = <1>;
		//qcom,mdss-dsi-bl-max-level = <4095>;
		qcom,mdss-dsi-dma-trigger = "trigger_sw";
		qcom,mdss-dsi-mdp-trigger = "none";
		//qcom,mdss-dsi-bl-pmic-control-type = "bl_ctrl_wled";
		qcom,mdss-dsi-reset-sequence = <1 100>, <1 0>, <1 0>;
	};
};
